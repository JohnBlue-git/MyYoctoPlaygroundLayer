## meta-johnblue/conf/layer.conf
```bitbake
# Tell where to find .bbclass .conf
BBPATH .= ":${LAYERDIR}"

# Tell where to find recipes and append files
# We have recipes-* directories
BBFILES += "${LAYERDIR}/recipes-*/*/*.bb \
            ${LAYERDIR}/recipes-*/*/*.bbappend"
# Register the layer
BBFILE_COLLECTIONS += "johnblue"
BBFILE_PATTERN_johnblue := "^${LAYERDIR}/"
BBFILE_PRIORITY_johnblue = "6"

# Optional: compatible with your Yocto version (e.g. kirkstone or scarthgap)
#           to avoid WARNING when this layer is used
LAYERSERIES_COMPAT_johnblue = "kirkstone scarthgap"
```
